## config/boards/shields/Test/Kconfig.defconfig
```kconfig
if SHIELD_IKB_R

config ZMK_KEYBOARD_NAME
    default "IKB_R"

config ZMK_SPLIT
    default y

config ZMK_SPLIT_ROLE_CENTRAL
    default y

endif

if SHIELD_IKB_L

config ZMK_KEYBOARD_NAME
    default "IKB"

config ZMK_SPLIT
    default y

endif
```

## config/boards/shields/Test/Kconfig.shield
```kconfig
config SHIELD_IKB_R
    def_bool $(shields_list_contains,IKB_R)

config SHIELD_IKB_L
    def_bool $(shields_list_contains,IKB_L)
```

## config/west.yml
```yaml
# =========================================================
# Date: 2026-04-09 22:13
# Filename: config/west.yml
# @details
# ZMKファームウェアの外部モジュール依存関係を定義するファイルです。
# Zephyr 4.1.0で標準搭載されたPMW3610ドライバーとの「名前衝突」を
# 回避するため、取得先を「inorichi」から「badjeff」に変更しています。
# これにより、互換性ラベルが pixart,pmw3610-alt に変更され、
# OSネイティブのドライバーと共存（競合回避）できるようになります。
# =========================================================

manifest:
  remotes:
    - name: zmkfirmware
      url-base: https://github.com/zmkfirmware
    - name: badjeff
      url-base: https://github.com/badjeff
    - name: your-git
      url-base: https://github.com/ikumoku

  projects:
    - name: zmk
      remote: zmkfirmware
      revision: 040238a97dfb55ad84867c007944809425f1befe
      import: app/west.yml

    - name: zmk-pmw3610-driver
      remote: badjeff
      revision: main

  self:
    path: config
```
